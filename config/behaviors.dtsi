\ {
    behaviors {
        hm: homerow_mods {
            compatible = "zmk,behavior-hold-tap";
            label = "HOMEROW_MODS";
            #binding-cells = <2>;
            tapping-term-ms = <200>;
            quick-tap-ms = <150>;
            flavor = "balanced";
            bindings = <&kp>, <&kp>;
        };
    };
};
